;--------------------------------------------------------------------------
;
;	OSEK/ORTI Example for TRACE32 multitask debugger
;
;--------------------------------------------------------------------------

; create menu with external program
OS.Area /usr/local/t32/demo/kernel/orti/genmenu.exe Debug/system.orti

; initialize ORTI support
 print "initializing ORTI support..."
 TASK.ORTI conf.orti        ; ORTI awareness
 MENU.ReProgram orti        ; OSEK objects menu
 MENU.ReProgram ortiperf    ; trace and performance menu

 print "load complete."

 enddo
