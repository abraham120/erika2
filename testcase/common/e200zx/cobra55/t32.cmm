; script used to load modistarc tests

&use_vle=#USE_VLE#
&filename="#EXE_NAME#"

&path=OS.PPD()

SYStem.RESet

SYStem.CPU MPC55XX
SYStem.DETECT CPU
SYStem.BdmClock 4.MHz

if POWERNEXUS()
(
  Trace.Method Analyzer
  Trace.Init
  
  if ID.CABLE()==2
    ;NEXUS.PortSize MDO16 ;LA-7630 (Nexus-AutoFocus adapter)
    NEXUS.PortSize MDO12 ;LA-7630 (Nexus-AutoFocus adapter)
  else
    NEXUS.PortSize MDO12 ;LA-7610 (supports only up to MDO12)
)
else if SIMULATOR()
(
  Trace.Method Analyzer
  Trace.Init
)
else
(
  Trace.Method Onchip
  Trace.Init
)

if !SIMULATOR()
(
  ;enable real time memory access via NEXUS block
  SYStem.MemAccess NEXUS
)

;connect and reset processor
SYStem.UP

if &use_vle==1
    &vle_flag=0x20
else
    &vle_flag=0

;set up the TLBs the same as the BAM
MMU.Set.TLB1 0. 0x80000300 0x40000000+&vle_flag 0x4000003f
MMU.Set.TLB1 1. 0x80000500 0xC3F00008+&vle_flag 0xC3F0003F
MMU.Set.TLB1 2. 0xC0000580 0xFFE0000A+&vle_flag 0xFFE0003F

;initialize SRAM
Data.Set EA:0x40000000--0x4007FFFF %Quad 0

;load program to SRAM
;print "&path"
;stop
Data.LOAD Debug/ppc.elf

if &use_vle==1
  SYStem.Option.DISMODE VLE

B.Set EE_assert_last

Go __start

wait !run() 5.s
if run()
(
  break
)

b.delete

if (data.byte(EE_assertions)==0x1)
(
  ;test successful
  AREA.select Messages
  print "OK!!!"
  print
  AREA.Select A000
  write #1 "Test OK"
  enddo
)
else
(
  area.view
  AREA.select Messages
  print
  print "----------------------------------------"
  print " TEST FAILED !!!!!!!"
  print "----------------------------------------"
  print
  AREA.Select A000
  write #1 "Test Failed"
  &failed=&failed+1
)
