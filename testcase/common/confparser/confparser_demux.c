/* ###*B*###
 * ERIKA Enterprise - a tiny RTOS for small microcontrollers
 *
 * Copyright (C) 2002-2008  Evidence Srl
 *
 * This file is part of ERIKA Enterprise.
 *
 * ERIKA Enterprise is free software; you can redistribute it
 * and/or modify it under the terms of the GNU General Public License
 * version 2 as published by the Free Software Foundation, 
 * (with a special exception described below).
 *
 * Linking this code statically or dynamically with other modules is
 * making a combined work based on this code.  Thus, the terms and
 * conditions of the GNU General Public License cover the whole
 * combination.
 *
 * As a special exception, the copyright holders of this library give you
 * permission to link this code with independent modules to produce an
 * executable, regardless of the license terms of these independent
 * modules, and to copy and distribute the resulting executable under
 * terms of your choice, provided that you also meet, for each linked
 * independent module, the terms and conditions of the license of that
 * module.  An independent module is a module which is not derived from
 * or based on this library.  If you modify this code, you may extend
 * this exception to your version of the code, but you are not
 * obligated to do so.  If you do not wish to do so, delete this
 * exception statement from your version.
 *
 * ERIKA Enterprise is distributed in the hope that it will be
 * useful, but WITHOUT ANY WARRANTY; without even the implied warranty
 * of MERCHANTABILITY or FITNESS FOR A PARTICULAR PURPOSE.  See the
 * GNU General Public License version 2 for more details.
 *
 * You should have received a copy of the GNU General Public License
 * version 2 along with ERIKA Enterprise; if not, write to the
 * Free Software Foundation, Inc., 51 Franklin Street, Fifth Floor,
 * Boston, MA 02110-1301 USA.
 * ###*E*### */

/*
 * CONFPARSER_DEMUX
 *
 * This program receives its input from the command line and prints a
 * demuxed version of the string.
 *
 * Example: confparser_mux a_b_c_d
 *
 * Output: a=b c=d
 *
 * note: the input bust be a string generated by confparser_mux!!!
 */

#include <stdio.h>

#define NOPRINT

#define EQUAL 1
#define SPACE 2

void usage(void);

int main(int argc, char **argv)
{
  char *c;
  int state;

  if (argc != 2) {
    usage();
    return 1;
  }

  c = argv[1];
  state = EQUAL;

  do {
    if (*c=='_') {
      if (state == EQUAL)
	*c = '=', state = SPACE;
      else
	*c = ' ', state = EQUAL;
    }
    c++;
  } while (*c);

#ifndef NOPRINT
  fprintf(stderr,"DEMUX: \"%s\"\n", argv[1]);
#endif
  puts(argv[1]);

  return 0;
}

void usage(void)
{
  fprintf(stderr,
	  "---------------------------------------------------------------------------\n"
	  "CONFPARSER\n\n"
	  "Usage: This program receives its input from the command line\n"
	  "and prints a demuxed version of the string.\n\n"
	  "Example: confparser_demux a_b_c_d\n\n"
	  "Output: a=b c=d\n"
	  "---------------------------------------------------------------------------\n");
}
