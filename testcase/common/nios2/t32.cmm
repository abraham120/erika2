; script used to load t32_jobs.cmm.
; DO NOT MODIFY this script. Modify common/e7t_manual/t32_quit.cmm instead

global &current_jam
&current_jam="none"

area
area.create Messages 100 5000
area.view Messages

do t32_jobs.cmm

area.select Messages
print
print
print "Done."
print "-------------------------------------------------------"
print "-------------------------------------------------------"
print "-------------------------------------------------------"
print "-------------------------------------------------------"
area.select A000

