// T32 Mon Jan 23 11:06:32 2006

 B::
 
 TOOLBAR ON
 STATUSBAR ON
 WINPAGE.RESET
 
 WINCLEAR
 WINPOS 49.125 8.875 79. 24. 0. 0. W004 ICONIC
 term
 
 WINPOS 83.875 0.0625 45. 22. 0. 0. W003
 Register
 
 WINPOS 73.5 25.688 55. 5. 0. 0. W004
 Var.Watch
 
 
 WINPOS 0.0 0.0 80. 23. 13. 1. W002
 WINTABS 10. 10. 25. 62.
 d.l
 
 WINPOS 0.0 26.5 77. 4. 0. 0. W001
 area
 
 WINPAGE.SELECT P000     
 
 ENDDO
