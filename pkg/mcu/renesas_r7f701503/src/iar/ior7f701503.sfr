# ior7f701503 register map
Registers are 8-bit, access not given, no defined reset value unless marked. A register's access mark holds for its fields unless they carry their own. Addresses are absolute; registers are grouped by the start of their names; [hi:lo] are bit positions.

## CFOVFSTR
0xFFC6220C CFOVFSTR_VCI 32-bit ro
0xFFC6220C CFOVFSTR_VCIL 16-bit ro
0xFFC6220C CFOVFSTR_VCILL ro
0xFFC6240C CFOVFSTR_PE1 32-bit ro
0xFFC6240C CFOVFSTR_PE1L 16-bit ro
0xFFC6240C CFOVFSTR_PE1LL ro
0xFFC6260C CFOVFSTR_PE2 32-bit ro
0xFFC6260C CFOVFSTR_PE2L 16-bit ro
0xFFC6260C CFOVFSTR_PE2LL ro

## CF1STERSTR
0xFFC62210 CF1STERSTR_VCI 32-bit ro
0xFFC62210 CF1STERSTR_VCIL 16-bit ro
0xFFC62210 CF1STERSTR_VCILL ro
0xFFC62410 CF1STERSTR_PE1 32-bit ro
0xFFC62410 CF1STERSTR_PE1L 16-bit ro
0xFFC62410 CF1STERSTR_PE1LL ro
0xFFC62610 CF1STERSTR_PE2 32-bit ro
0xFFC62610 CF1STERSTR_PE2L 16-bit ro
0xFFC62610 CF1STERSTR_PE2LL ro

## CF1STEADR0
0xFFC62250 CF1STEADR0_VCI 32-bit ro
0xFFC62250 CF1STEADR0_VCIL 16-bit ro
0xFFC62250 CF1STEADR0_VCILL ro
0xFFC62251 CF1STEADR0_VCILH ro
0xFFC62252 CF1STEADR0_VCIH 16-bit ro
0xFFC62252 CF1STEADR0_VCIHL ro
0xFFC62253 CF1STEADR0_VCIHH ro
0xFFC62450 CF1STEADR0_PE1 32-bit ro
0xFFC62450 CF1STEADR0_PE1L 16-bit ro
0xFFC62450 CF1STEADR0_PE1LL ro
0xFFC62451 CF1STEADR0_PE1LH ro
0xFFC62452 CF1STEADR0_PE1H 16-bit ro
0xFFC62452 CF1STEADR0_PE1HL ro
0xFFC62453 CF1STEADR0_PE1HH ro
0xFFC62650 CF1STEADR0_PE2 32-bit ro
0xFFC62650 CF1STEADR0_PE2L 16-bit ro
0xFFC62650 CF1STEADR0_PE2LL ro
0xFFC62651 CF1STEADR0_PE2LH ro
0xFFC62652 CF1STEADR0_PE2H 16-bit ro
0xFFC62652 CF1STEADR0_PE2HL ro
0xFFC62653 CF1STEADR0_PE2HH ro

## CFSTSTCTL
0xFFC62350 CFSTSTCTL_VCI 32-bit
0xFFC62350 CFSTSTCTL_VCIL 16-bit
0xFFC62550 CFSTSTCTL_PE1 32-bit
0xFFC62550 CFSTSTCTL_PE1L 16-bit
0xFFC62750 CFSTSTCTL_PE2 32-bit
0xFFC62750 CFSTSTCTL_PE2L 16-bit

## GRECCCTL
0xFFC64000 GRECCCTL_GRAMC 32-bit
0xFFC64000 GRECCCTL_GRAMCL 16-bit
0xFFC64200 GRECCCTL_VCI 32-bit
0xFFC64200 GRECCCTL_VCIL 16-bit
0xFFC64400 GRECCCTL_PE1 32-bit
0xFFC64400 GRECCCTL_PE1L 16-bit
0xFFC64600 GRECCCTL_PE2 32-bit
0xFFC64600 GRECCCTL_PE2L 16-bit

## GRERRINT
0xFFC64204 GRERRINT_VCI 32-bit
0xFFC64204 GRERRINT_VCIL 16-bit
0xFFC64204 GRERRINT_VCILL
0xFFC64404 GRERRINT_PE1 32-bit
0xFFC64404 GRERRINT_PE1L 16-bit
0xFFC64404 GRERRINT_PE1LL
0xFFC64604 GRERRINT_PE2 32-bit
0xFFC64604 GRERRINT_PE2L 16-bit
0xFFC64604 GRERRINT_PE2LL

## GRSTCLR
0xFFC64208 GRSTCLR_VCI 32-bit wo
0xFFC64208 GRSTCLR_VCIL 16-bit wo
0xFFC64208 GRSTCLR_VCILL wo
0xFFC64408 GRSTCLR_PE1 32-bit wo
0xFFC64408 GRSTCLR_PE1L 16-bit wo
0xFFC64408 GRSTCLR_PE1LL wo
0xFFC64608 GRSTCLR_PE2 32-bit wo
0xFFC64608 GRSTCLR_PE2L 16-bit wo
0xFFC64608 GRSTCLR_PE2LL wo

## GROVFSTR
0xFFC6420C GROVFSTR_VCI 32-bit ro
0xFFC6420C GROVFSTR_VCIL 16-bit ro
0xFFC6420C GROVFSTR_VCILL ro
0xFFC6440C GROVFSTR_PE1 32-bit ro
0xFFC6440C GROVFSTR_PE1L 16-bit ro
0xFFC6440C GROVFSTR_PE1LL ro
0xFFC6460C GROVFSTR_PE2 32-bit ro
0xFFC6460C GROVFSTR_PE2L 16-bit ro
0xFFC6460C GROVFSTR_PE2LL ro

## GR1STERSTR
0xFFC64210 GR1STERSTR_VCI 32-bit ro
0xFFC64210 GR1STERSTR_VCIL 16-bit ro
0xFFC64210 GR1STERSTR_VCILL ro
0xFFC64211 GR1STERSTR_VCILH ro
0xFFC64410 GR1STERSTR_PE1 32-bit ro
0xFFC64410 GR1STERSTR_PE1L 16-bit ro
0xFFC64410 GR1STERSTR_PE1LL ro
0xFFC64411 GR1STERSTR_PE1LH ro
0xFFC64610 GR1STERSTR_PE2 32-bit ro
0xFFC64610 GR1STERSTR_PE2L 16-bit ro
0xFFC64610 GR1STERSTR_PE2LL ro
0xFFC64611 GR1STERSTR_PE2LH ro

## GR1STEADR0
0xFFC64250 GR1STEADR0_VCI 32-bit ro
0xFFC64250 GR1STEADR0_VCIL 16-bit ro
0xFFC64250 GR1STEADR0_VCILL ro
0xFFC64251 GR1STEADR0_VCILH ro
0xFFC64252 GR1STEADR0_VCIH 16-bit ro
0xFFC64252 GR1STEADR0_VCIHL ro
0xFFC64450 GR1STEADR0_PE1 32-bit ro
0xFFC64450 GR1STEADR0_PE1L 16-bit ro
0xFFC64450 GR1STEADR0_PE1LL ro
0xFFC64451 GR1STEADR0_PE1LH ro
0xFFC64452 GR1STEADR0_PE1H 16-bit ro
0xFFC64452 GR1STEADR0_PE1HL ro
0xFFC64650 GR1STEADR0_PE2 32-bit ro
0xFFC64650 GR1STEADR0_PE2L 16-bit ro
0xFFC64650 GR1STEADR0_PE2LL ro
0xFFC64651 GR1STEADR0_PE2LH ro
0xFFC64652 GR1STEADR0_PE2H 16-bit ro
0xFFC64652 GR1STEADR0_PE2HL ro
