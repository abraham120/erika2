//-------------------------------------------------------------------------
//      ILINK command file template for RH850 microcontroller R7F701503.
//
//      This file can be used to link object files from the RH850
//      Assembler, IASMRH850, and the C/C++ compiler ICCRH850.
//
//          This file is generated from the device file:
//          dr7f701503.dvf
//          Copyright(C) 2014 Renesas
//          Format version 1.20, File version 1.10 
//-------------------------------------------------------------------------

define memory mem with size = 4G;                                        // Section name    Memory type
                                                                         // ------------    -----------

define symbol _SELF_SIZE = 0x00018000;                                   // SELF_AREA SIZE

define region ROM_near       = mem:[from 0x00000000 to 0x00007FFF];      // <code default>  Code FLASH
define region ROM_1ST_region = mem:[from 0x00000000 to 0x003FFFFF];      // <code default>  Code FLASH
define region ROM_2ND_region = mem:[from 0x00800000 to 0x009FFFFF];      // SECOND_ROM      Code FLASH
define region ROM_3RD_region = mem:[from 0x01000000 to 0x01007FFF];      // THIRD_ROM       Code FLASH
define region ROM_4TH_region = mem:[from 0x00000000 size 0];
define region ROM_5TH_region = mem:[from 0x00000000 size 0];

define region RAM_near       = mem:[from 0x00000000 size 0];
define exported symbol _RAM_1ST_BEG = 0xFEFF8000;
define exported symbol _RAM_1ST_END = 0xFEFFFFFF;
define region RAM_1ST_region = mem:[from _RAM_1ST_BEG to _RAM_1ST_END];  // <data default>  Global RAM
define exported symbol _RAM_2ND_BEG = 0xFEEF8000;
define exported symbol _RAM_2ND_END = 0xFEEFFFFF;
define region RAM_2ND_region = mem:[from _RAM_2ND_BEG to _RAM_2ND_END];  // SECOND_RAM      Global RAM
define exported symbol _RAM_3RD_BEG = 0x00000000;
define exported symbol _RAM_3RD_END = 0x00000000;
define region RAM_3RD_region = mem:[from 0x00000000 size 0];
define exported symbol _RAM_4TH_BEG = 0x00000000;
define exported symbol _RAM_4TH_END = 0x00000000;
define region RAM_4TH_region = mem:[from 0x00000000 size 0];
define exported symbol _RAM_5TH_BEG = 0x00000000;
define exported symbol _RAM_5TH_END = 0x00000000;
define region RAM_5TH_region = mem:[from 0x00000000 size 0];

define exported symbol _SELF_AREA_BEG = 0xFEDD0000;
define exported symbol _SELF_AREA_END = 0xFEDFFFFF;
define region SELF_AREA_region = mem:[from _SELF_AREA_BEG size _SELF_SIZE];  // SELF AREA

define exported symbol _LOC_1ST_BEG = 0xFEBD0000;
define exported symbol _LOC_1ST_END = 0xFEBFFFFF;
define region LOC_1ST_region = mem:[from _LOC_1ST_BEG+_SELF_SIZE to _LOC_1ST_END];  // LOCAL1_RAM      Local RAM for PE1
define exported symbol _LOC_2ND_BEG = 0xFE9D0000;
define exported symbol _LOC_2ND_END = 0xFE9FFFFF;
define region LOC_2ND_region = mem:[from _LOC_2ND_BEG+_SELF_SIZE to _LOC_2ND_END];  // LOCAL2_RAM      Local RAM for PE2
define exported symbol _LOC_3RD_BEG = 0x00000000;
define exported symbol _LOC_3RD_END = 0x00000000;
define region LOC_3RD_region = mem:[from 0x00000000 size 0];
define exported symbol _LOC_4TH_BEG = 0x00000000;
define exported symbol _LOC_4TH_END = 0x00000000;
define region LOC_4TH_region = mem:[from 0x00000000 size 0];
define exported symbol _LOC_5TH_BEG = 0x00000000;
define exported symbol _LOC_5TH_END = 0x00000000;
define region LOC_5TH_region = mem:[from 0x00000000 size 0];
define exported symbol _LOC_6TH_BEG = 0x00000000;
define exported symbol _LOC_6TH_END = 0x00000000;
define region LOC_6TH_region = mem:[from 0x00000000 size 0];
define exported symbol _LOC_7TH_BEG = 0x00000000;
define exported symbol _LOC_7TH_END = 0x00000000;
define region LOC_7TH_region = mem:[from 0x00000000 size 0];

define exported symbol _RAM_RET_BEG = 0xFEF00000;
define exported symbol _RAM_RET_END = 0xFEF1FFFF;
define region RAM_RET_region = mem:[from _RAM_RET_BEG to _RAM_RET_END];  // RETENTION_RAM   Retention RAM

//Uncomment and adapt the following section if you want to place the interrupt tables at specific addresses.
// define block .interrupt_core1 with alignment = 8 {
//   ro section .table.interrupt_core_1 };
//
// "INTERRUPT":place at address mem:0x200
// {
//   block .interrupt_core1
// };

include "mylayout.icf";

//-------------------------------------------------------------------------
//      End of file
//-------------------------------------------------------------------------
