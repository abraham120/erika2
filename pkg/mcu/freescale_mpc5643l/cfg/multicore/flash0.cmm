;
; Script to run ERIKA from ROM
;

; evi - ERIKA binary object and VLE setting (from the makefile)
&filename="#EXE_NAME#"
&use_vle=#USE_VLE#

SYStem.RESet
&core2 SYStem.RESet

SYNCH.RESet
&core2 SYNCH.RESET

;system settings
;1. detect CPU type
SYStem.CPU 55XX
SYStem.UP
&cpu=CPU()

;1.configure both PowerView instances for detected CPU
SYStem.CPU &cpu
SYStem.BdmClock 4.MHz

&core2 SYStem.CPU &cpu
&core2 SYStem.BdmClock 4.MHz

;setup for multi-core debugging
SYStem.CONFIG.CORE 1. 1.
&core2 SYStem.CONFIG.CORE 2. 1.
&core2 SYStem.CONFIG.SLAVE ON

if POWERNEXUS()
(
  Trace.Method Analyzer
  Trace.AutoArm ON
  
  &core2 Trace.Method Analyzer
  &core2 Trace.AutoArm ON
  
  Trace.XTRACK localhost:10001
  &core2 Trace.XTRACK localhost:10000
)

;Z4: halt on POR 
SYStem.Up

;slave Z4: still in reset, attach only
&core2 SYStem.Mode.Attach

;slave Z4: on a Break while in reset, the debugger will stop Z4 as soon as
; the master Z4 program wakes slave Z4 up from reset
&core2 Break

; setup MMU for flash, RAM and register access, as BAM does
GOSUB setup_mmu &use_vle

; initialize internal SRAM
Data.Set EA:0x40000000--0x4000FFFF %quad 0
Data.Set EA:0x50000000--0x5000FFFF %quad 0

;disable mmu bypass
Data.Set SPR:0x3F4 %LONG 0x00000000

if POWERNEXUS()
(
  Trace.INIT
  &core2 Trace.INIT
)

d.load.elf &filename /NOCODE

#ORTICMD#

; Evidence - Francesco E: check if the symbol exist
if symbol.exist(mem_write_code)
(
    if &use_vle==1
    (
        ; Evidence - Francesco E. Mark 3 crazy instructions in boot code
        ; as VLE to prevent Lauterbach from uncorrect VLE decoding
        sYmbol.NEW.ATTRibute VLE mem_write_code++0xB
    )
    else
    (
        ; Evidence - Francesco E. Mark 3 crazy instructions in boot code
        ; as FLE to prevent Lauterbach from uncorrect FLE decoding
        sYmbol.NEW.ATTRibute FLE mem_write_code++0xB
    )
)

; Francesco E: enable HTM feature
NEXUS.HTM ON

ENDDO

setup_mmu:
	ENTRY &set_vle
	if &set_vle==1
		&vle_flag=0x20
	else
		&vle_flag=0
	MMU.TLB1.SET 0x0 0x00000000 0x00000000+&vle_flag 0x00000000
    MMU.TLB1.SET 0x1 0xC0000500 0xFFF0000A+&vle_flag 0xFFF0003F
    MMU.TLB1.SET 0x2 0xC0000700 0x20000000+&vle_flag 0x2000003F
    MMU.TLB1.SET 0x3 0xC0000400 0x40000008+&vle_flag 0x4000003F
    MMU.TLB1.SET 0x4 0xC0000500 0xC3F00008+&vle_flag 0xC3F0003F
    MMU.TLB1.SET 0x5 0xC0000700 0x00000000+&vle_flag 0x0000003F
	RETURN

