;
; Script to run ERIKA in MPC5644A from RAM 
;
; Francesco Esposito 23-03-2012
; Eugen Kleinschmidt 03-06-2013
;

; evi - ERIKA binary object and VLE setting (from the makefile)
&filename="#EXE_NAME#"
&use_vle=#USE_VLE#


SYStem.RESet
SYStem.BdmClock 4.0MHz
SYStem.CPU MPC5644A
NExus.PORTSIze MDO4
NExus.Dtm ReadWrite
NExus.PORTMode 1/2
SYStem.Option.WATCHDOG OFF
SYStem.Up

; initialize internal SRAM
Data.Set EA:0x40000000--0x40007fff %quad 0x0

; setup MMU for flash, RAM and register access, as BAM does
GOSUB setup_mmu &use_vle

d.load.elf &filename /PlusVM

#ORTICMD#

ENDDO

setup_mmu:
	ENTRY &set_vle
	if &set_vle==1
		&vle_flag=0x20
	else
		&vle_flag=0

    ; 4 GB from 0x0 as not Guarded, Cachable, All Access. 
    MMU.TLB1.SET 0x0 0xC0000B00 0x00000002+&vle_flag 0x0000003F

	RETURN
