// T32 Thu Nov 28 14:30:30 2002

 B::
 
 TOOLBAR ON
 STATUSBAR ON
 CMDPOS 9.5 3.8125 133. 12.
 WINPAGE.RESET
 
 WINCLEAR
 WINPOS 2.0 45.625 95. 13. 0. 0. W000
 per.view t32/evaluator7t.per
 
 WINPOS 1.625 14.437 48. 30. 0. 0. W001
 Register /SPOTLIGHT
 
 WINPOS 105.0 45.25 49. 12. 0. 0. W002
 v.w
 
 
 WINPOS 54.375 16.187 102. 25. 13. 1. W003
 WINTABS 10. 10. 25. 62.
 Data.List
 
 WINPAGE.SELECT P000     
 
 ENDDO
